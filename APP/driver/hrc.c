/************************************************************************/
/* 名称：心率计算模块
 * 描述：
 * 编写：邹应龙
 * 更新：2015-01-04                                                 */
/************************************************************************/

#include "../main.h"
#define BASE_PULSE		75


static struct 
{
	u8 		cnt;		//序号
	u32 	buf[4];		//存储四格计时数据

}buf_hrc;
/************************************************************************/
/* 功能：数组遍历求最大值
 * 描述：
 * 形参：数组地址，数据个数
 * 返回：最大值
 * 修改：                    */
/************************************************************************/
 static u32 hrc_get_max(void)
 {
 	u32 max = buf_hrc.buf[0];	//第一个数据

 	for (u8 i=1;i<4;i++)
 	{
		 if(buf_hrc.buf[i]>max)
		 {
		 	max = buf_hrc.buf[i];
		 }
 	}
 	return max;								//返回
 }


/************************************************************************/
/* 功能：数组遍历求最小值
 * 描述：
 * 形参：数组地址，数据个数
 * 返回：最小值
 * 修改：                    */
/************************************************************************/
static u32 hrc_get_min(void)
{
 	u32 min = buf_hrc.buf[0];	//第一个数据
 	for (u8 i=1;i<4;i++)
 	{
		 if(buf_hrc.buf[i]<min)
		 {
		 	min = buf_hrc.buf[i];
		 }
 	}
 	return min;								//返回
}


/************************************************************************/
/* 功能：数组存入数据
 * 描述：只用于心率
 * 形参：存入数据
 * 返回：                 */
/************************************************************************/
 static void input_hrc_time(u32 dat)
 {
 	buf_hrc.buf[buf_hrc.cnt] = dat;
 	buf_hrc.cnt++;
 	if(buf_hrc.cnt>3)
 		buf_hrc.cnt = 0;
 }

/************************************************************************/
/* 功能：计算显示心率
 * 描述：当测试心率大于显示心率，显示心率加1,反之减1.
 * 形参：测试心率
 * 返回：
 * 修改：                    */
/************************************************************************/
static void hrc_cal(u16 now_pulse)
{
  	s16 var = hrc.cur;
	if(var == 0)
	{
		hrc.cur = BASE_PULSE;
	}
	else if(now_pulse > var)
	{
		if(hrc.cur < 250)
			hrc.cur++;
	}
	else
	{
		if(hrc.cur > 30)
			hrc.cur--;
	}
}

/************************************************************************/
/* 功能：计算测试心率
 * 描述：当数组满的时候，循环写入，循环检测
 * 形参：
 * 返回：
 * 修改：                    */
/************************************************************************/
static void hrc_counter(void)
{
	u8	now_pulse;			//判断错误信息
	u32 max_time;
	u32 min_time;
	u16 time_gap;

	/*向数组循环写入jiffies,一次jiffies=10ms*/
	input_hrc_time(os.jiffies);
	if (buf_hrc.buf[3] != 0)
	{
		max_time = hrc_get_max();
		min_time = hrc_get_min();

		time_gap = (u16)((max_time - min_time) /3);			//求出一段平均周期，单位10ms
		now_pulse = 6000/time_gap;					//心率=1min(6000个10ms)/每个心率多少10m
		hrc_cal(now_pulse);						//调用显示心率计算
	}
}

/************************************************************************/
/* 功能：侦测到心率 
 * 描述：心率未激活时持续高电平。激活时高电平200+ms，低电平500-ms。
 * 形参：
 * 返回：                  */
/************************************************************************/
 /* 
  * 下降沿开始计数。功能pulse_prev写1表面脉冲开始，pulse_wait写0表示待机结束
  */

void interrupt_hrc_get(void)
{	
	if(PC_IDR_IDR1 == 0)	
	{
		hrc_counter();
		freq.hrc_clr = OS_SEC_10;			//心率占用led 10s		
	}
}
void hrc_wake(void)
{
	if (freq.hrc_clr == 0)
	{
		hrc.cur = 0;
	}
}